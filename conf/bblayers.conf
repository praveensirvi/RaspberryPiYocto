## conf/bblayers.conf
```bitbake
# POKY_BBLAYERS_CONF_VERSION is increased each time build/conf/bblayers.conf
# changes incompatibly
POKY_BBLAYERS_CONF_VERSION = "2"

BBPATH = "${TOPDIR}"
BBFILES ?= ""

BBLAYERS ?= " \
  /home/praveen/learnings/yocto/poky/meta \
  /home/praveen/learnings/yocto/poky/meta-poky \
  /home/praveen/learnings/yocto/poky/meta-yocto-bsp \
  /home/praveen/learnings/yocto/poky/meta-openembedded/meta-oe \
  /home/praveen/learnings/yocto/poky/meta-openembedded/meta-multimedia \
  /home/praveen/learnings/yocto/poky/meta-openembedded/meta-networking \
  /home/praveen/learnings/yocto/poky/meta-openembedded/meta-python \
  /home/praveen/learnings/yocto/poky/meta-raspberrypi \
  "
```

## conf/local.conf
```bitbake
## This is my configuration file
MACHINE = "raspberrypi3-64"
DISTRO ?= "poky"

PACKAGE_CLASSES ?= "package_rpm"
EXTRA_IMAGE_FEATURES ?= "debug-tweaks ssh-server-openssh"
USER_CLASSES ?= "buildstats image-mklibs image-prelink"
PATCHRESOLVE = "noop"
CONF_VERSION = "1"

SSTATE_DIR ?= "/home/praveen/learnings/yocto/poky/build/sstate-cache"
TMPDIR ?= "/home/praveen/learnings/yocto/poky/build/tmp"
DL_DIR ?= "/home/praveen/learnings/yocto/poky/build/downloads"

PACKAGECONFIG_append_pn-qemu-native = " sdl"
PACKAGECONFIG_append_pn-nativesdk-qemu = " sdl"
BB_DISKMON_DIRS ??= "\
    STOPTASKS,${TMPDIR},1G,100K \
    STOPTASKS,${DL_DIR},1G,100K \
    STOPTASKS,${SSTATE_DIR},1G,100K \
    STOPTASKS,/tmp,100M,100K \
    ABORT,${TMPDIR},100M,1K \
    ABORT,${DL_DIR},100M,1K \
    ABORT,${SSTATE_DIR},100M,1K \
    ABORT,/tmp,10M,1K"

#SDKMACHINE ?= "i686"
#ASSUME_PROVIDED += "libsdl-native"DISTRO_FEATURES_remove = "x11 wayland"
DISTRO_FEATURES_append = " bluez5 bluetooth wifi systemd"
VIRTUAL-RUNTIME_init_manager = "systemd"

IMAGE_INSTALL_append += " linux-firmware-brcm43430 bluez5 i2c-tools python-smbus bridge-utils hostapd dhcp-server iptables wpa-supplicant"
```
